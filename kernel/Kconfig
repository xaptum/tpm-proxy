## kernel/Kconfig
```kconfig
#
# TPM Proxy Driver
#

config TPMPROXY
       tristate "TPM Proxy Driver"
       depends on USB_SUPPORT
       ---help---

         Say Y here if you want to support the TPM proxy driver to
         expose a TPM on an attached embedded Linux device as a device
         on the host. This driver is used to provision the TPM on the
         Xaptum router cards.

         To compile this driver as a module, choose M here. The module
         will be called tpmproxy.

         If unsure, say M.
```
